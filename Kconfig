## Kconfig
```kconfig
mainmenu "NEMU Configuration Menu"

choice
  prompt "Base ISA"
  default ISA_riscv
config ISA_x86
  bool "x86"
config ISA_mips32
  bool "mips32"
config ISA_riscv
  bool "riscv"
config ISA_loongarch32r
  bool "loongarch32r"
endchoice

config ISA
  string
  default "x86" if ISA_x86
  default "mips32" if ISA_mips32
  default "riscv32" if ISA_riscv && !RV64
  default "riscv64" if ISA_riscv &&  RV64
  default "loongarch32r" if ISA_loongarch32r
  default "none"

config ISA64
  depends on ISA_riscv && RV64
  bool
  default y


if ISA_riscv
source "src/isa/riscv32/Kconfig"
endif

choice
  prompt "NEMU execution engine"
  default ENGINE_INTERPRETER

config ENGINE_INTERPRETER
  bool "Interpreter"
  help
    Interpreter guest instructions one by one.
endchoice

config ENGINE
  string
  default "interpreter" if ENGINE_INTERPRETER
  default "none"

choice
  prompt "Running mode"
  default MODE_SYSTEM

config MODE_SYSTEM
  bool "System mode"
  help
    Support full-system functionality, including privileged instructions, MMU and devices.
endchoice

choice
  prompt "Build target"
  default TARGET_NATIVE_ELF
config TARGET_NATIVE_ELF
  bool "Executable on Linux Native"
config TARGET_SHARE
  bool "Shared object (used as REF for differential testing)"
config TARGET_AM
  bool "Application on Abstract-Machine (DON'T CHOOSE)"
endchoice

menu "Build Options"
choice
  prompt "Compiler"
  default CC_GCC
config CC_GCC
  bool "gcc"
config CC_GPP
  bool "g++"
config CC_CLANG
  depends on !TARGET_AM
  bool "clang"
endchoice

config CC
  string
  default "gcc" if CC_GCC
  default "g++" if CC_GPP
  default "clang" if CC_CLANG
  default "none"

choice
  prompt "Optimization Level"
  default CC_O2
config CC_O0
  bool "O0"
config CC_O1
  bool "O1"
config CC_O2
  bool "O2"
config CC_O3
  bool "O3"
endchoice

config CC_OPT
  string
  default "-O0" if CC_O0
  default "-O1" if CC_O1
  default "-O2" if CC_O2
  default "-O3" if CC_O3
  default "none"

config CC_LTO
  depends on !TARGET_AM
  bool "Enable link-time optimization"
  default n

config CC_DEBUG
  bool "Enable debug information"
  default n

config CC_ASAN
  depends on MODE_SYSTEM
  bool "Enable address sanitizer"
  default n
endmenu

menu "Testing and Debugging"


config TRACE
  bool "Enable tracer"
  default y

config TRACE_START
  depends on TRACE
  int "When tracing is enabled (unit: number of instructions)"
  default 0

config TRACE_END
  depends on TRACE
  int "When tracing is disabled (unit: number of instructions)"
  default 10000

config ITRACE
  depends on TRACE && TARGET_NATIVE_ELF && ENGINE_INTERPRETER
  bool "Enable instruction tracer"
  default y

config ITRACE_COND
  depends on ITRACE
  string "Only trace instructions when the condition is true"
  default "true"


config DIFFTEST
  depends on TARGET_NATIVE_ELF
  bool "Enable differential testing"
  default n
  help
    Enable differential testing with a reference design.
    Note that this will significantly reduce the performance of NEMU.

choice
  prompt "Reference design"
  default DIFFTEST_REF_SPIKE if ISA_riscv
  default DIFFTEST_REF_KVM if ISA_x86
  default DIFFTEST_REF_QEMU
  depends on DIFFTEST
config DIFFTEST_REF_QEMU
  bool "QEMU, communicate with socket"
if ISA_riscv
config DIFFTEST_REF_SPIKE
  bool "Spike"
endif
if ISA_x86
config DIFFTEST_REF_KVM
  bool "KVM"
endif
endchoice

config DIFFTEST_REF_PATH
  string
  default "tools/qemu-diff" if DIFFTEST_REF_QEMU
  default "tools/kvm-diff" if DIFFTEST_REF_KVM
  default "tools/spike-diff" if DIFFTEST_REF_SPIKE
  default "none"

config DIFFTEST_REF_NAME
  string
  default "qemu" if DIFFTEST_REF_QEMU
  default "kvm" if DIFFTEST_REF_KVM
  default "spike" if DIFFTEST_REF_SPIKE
  default "none"
endmenu

if MODE_SYSTEM
source "src/memory/Kconfig"
source "src/device/Kconfig"
endif


menu "Miscellaneous"
choice
  depends on !TARGET_AM
  prompt "Host timer"
  default TIMER_GETTIMEOFDAY
config TIMER_GETTIMEOFDAY
  bool "gettimeofday"
config TIMER_CLOCK_GETTIME
  bool "clock_gettime"
endchoice

config RT_CHECK
  bool "Enable runtime checking"
  default y

endmenu
```

## configs/mips32-am_defconfig
```kconfig
CONFIG_ISA_mips32=y
CONFIG_TARGET_AM=y
# CONFIG_TRACE is not set
CONFIG_MSIZE=0x2000000
CONFIG_DEVICE=y
```

## configs/riscv64-am_defconfig
```kconfig
CONFIG_RV64=y
CONFIG_TARGET_AM=y
# CONFIG_TRACE is not set
CONFIG_MSIZE=0x2000000
CONFIG_DEVICE=y
```

## src/device/Kconfig
```kconfig
menuconfig DEVICE
  depends on !TARGET_SHARE
  bool "Devices"
  default n
  help
    Provide device support for NEMU.

if DEVICE

config HAS_PORT_IO
  bool
  default y if ISA_x86
  default n

menuconfig HAS_SERIAL
  bool "Enable serial"
  default y

if HAS_SERIAL
config SERIAL_PORT
  depends on HAS_PORT_IO
  hex "Port address of the serial controller"
  default 0x3f8

config SERIAL_MMIO
  hex "MMIO address of the serial controller"
  default 0xa00003f8

config SERIAL_INPUT_FIFO
  bool "Enable input FIFO with /tmp/nemu.serial"
  default n
endif # HAS_SERIAL

menuconfig HAS_TIMER
  bool "Enable timer"
  default y

if HAS_TIMER
config RTC_PORT
  depends on HAS_PORT_IO
  hex "Port address of the timer"
  default 0x48

config RTC_MMIO
  hex "MMIO address of the timer"
  default 0xa0000048
endif # HAS_TIMER

menuconfig HAS_KEYBOARD
  bool "Enable keyboard"
  default y

if HAS_KEYBOARD
config I8042_DATA_PORT
  depends on HAS_PORT_IO
  hex "Port address of the keyboard controller"
  default 0x60

config I8042_DATA_MMIO
  hex "MMIO address of the keyboard controller"
  default 0xa0000060
endif # HAS_KEYBOARD

menuconfig HAS_VGA
  bool "Enable VGA"
  default y

if HAS_VGA
config FB_ADDR
  hex "Physical address of the VGA frame buffer"
  default 0xa1000000

config VGA_CTL_PORT
  depends on HAS_PORT_IO
  hex "Port address of the VGA controller"
  default 0x100

config VGA_CTL_MMIO
  hex "MMIO address of the VGA controller"
  default 0xa0000100

config VGA_SHOW_SCREEN
  bool "Enable SDL SCREEN"
  default y

choice
  prompt "Screen Size"
  default VGA_SIZE_400x300
config VGA_SIZE_400x300
  bool "400 x 300"
config VGA_SIZE_800x600
  bool "800 x 600"
endchoice
endif # HAS_VGA

if !TARGET_AM
menuconfig HAS_AUDIO
  bool "Enable audio"
  default y

if HAS_AUDIO
config SB_ADDR
  hex "Physical address of the audio stream buffer"
  default 0xa1200000

config SB_SIZE
  hex "Size of the audio stream buffer"
  default 0x10000

config AUDIO_CTL_PORT
  depends on HAS_PORT_IO
  hex "Port address of the audio controller"
  default 0x200

config AUDIO_CTL_MMIO
  hex "MMIO address of the audio controller"
  default 0xa0000200
endif # HAS_AUDIO

menuconfig HAS_DISK
  bool "Enable disk"
  default y

if HAS_DISK
config DISK_CTL_PORT
  depends on HAS_PORT_IO
  hex "Port address of the disk controller"
  default 0x300

config DISK_CTL_MMIO
  hex "MMIO address of the disk controller"
  default 0xa0000300

config DISK_IMG_PATH
  string "The path of disk image"
  default ""
endif # HAS_DISK

menuconfig HAS_SDCARD
  bool "Enable sdcard"
  default n

if HAS_SDCARD
config SDCARD_CTL_MMIO
  hex "MMIO address of the sdcard controller"
  default 0xa3000000

config SDCARD_IMG_PATH
  string "The path of sdcard image"
  default ""
endif # HAS_SDCARD
endif

endif # DEVICE
```

## src/isa/riscv32/Kconfig
```kconfig
menu "ISA-dependent Options for riscv"

config RV64
  bool "64-bit RISC-V architecture"
  default n

config RVE
  bool "Use E extension"
  default n
endmenu
```

## src/memory/Kconfig
```kconfig
menu "Memory Configuration"

config MBASE
  hex "Memory base address"
  default 0x0        if ISA_x86
  default 0x80000000

config MSIZE
  hex "Memory size"
  default 0x8000000

config PC_RESET_OFFSET
  hex "Offset of reset vector from the base of memory"
  default 0x100000 if ISA_x86
  default 0

choice
  prompt "Physical memory definition"
  default PMEM_GARRAY
config PMEM_MALLOC
  bool "Using malloc()"
config PMEM_GARRAY
  depends on !TARGET_AM
  bool "Using global array"
endchoice

config MEM_RANDOM
  depends on MODE_SYSTEM && !DIFFTEST && !TARGET_AM
  bool "Initialize the memory with random values"
  default y
  help
    This may help to find undefined behaviors.

endmenu #MEMORY
```
